## embedded/main/Kconfig.projbuild
```kconfig
menu "Snoozeless Embedded Configuration"
    config WIFI_SSID
        string "WiFi SSID"
        help
            SSID of the WiFi network to join.

    config WIFI_PASSWORD
        string "WiFi Password"
        help
            Password for the WiFi network to join.

    config ACCESS_TOKEN
        string "Access Token"
        help
            Session authorization bearer token.

    config REFRESH_TOKEN
        string "Refresh Token"
        help
            Session refresh token.

    config DEFAULT_BRIGHTNESS
        int "Default Display Brightness"
        help
            Default display brightness.

    config DEFAULT_TIME_ZONE
        string "Default Time Zone"
        help
            Default time zone.

    config DEFAULT_TIME_FORMAT
        string "Default Time Format"
        help
            Default time format.

    config I2C_FREQUENCY_HZ
        int "I2C bus frequency"
        default 400000
        help
            I2C bus frequency.

    config I2C_MASTER_SCL
        int "SCL GPIO Number"
        default 5 if IDF_TARGET_ESP8266
        default 6 if IDF_TARGET_ESP32C3
        default 19 if IDF_TARGET_ESP32 || IDF_TARGET_ESP32S2 || IDF_TARGET_ESP32S3
        help
            GPIO number for I2C Master clock line.

    config I2C_MASTER_SDA
        int "SDA GPIO Number"
        default 4 if IDF_TARGET_ESP8266
        default 5 if IDF_TARGET_ESP32C3
        default 18 if IDF_TARGET_ESP32 || IDF_TARGET_ESP32S2 || IDF_TARGET_ESP32S3
        help
            GPIO number for I2C Master data line.
endmenu
```
